/*******************************************************************************
* File Name: cyfittergnu.inc
* 
* PSoC Creator  4.4
*
* Description:
* 
* This file is automatically generated by PSoC Creator.
*
********************************************************************************
* Copyright (c) 2007-2020 Cypress Semiconductor.  All rights reserved.
* You may use this file only in accordance with the license, terms, conditions, 
* disclaimers, and limitations in the end user license agreement accompanying 
* the software package with which this file was provided.
********************************************************************************/

.ifndef INCLUDED_CYFITTERGNU_INC
.set INCLUDED_CYFITTERGNU_INC, 1
.include "cydevicegnu.inc"
.include "cydevicegnu_trm.inc"

/* InputPin */
.set InputPin__0__INTTYPE, CYREG_PICU6_INTTYPE1
.set InputPin__0__MASK, 0x02
.set InputPin__0__PC, CYREG_PRT6_PC1
.set InputPin__0__PORT, 6
.set InputPin__0__SHIFT, 1
.set InputPin__AG, CYREG_PRT6_AG
.set InputPin__AMUX, CYREG_PRT6_AMUX
.set InputPin__BIE, CYREG_PRT6_BIE
.set InputPin__BIT_MASK, CYREG_PRT6_BIT_MASK
.set InputPin__BYP, CYREG_PRT6_BYP
.set InputPin__CTL, CYREG_PRT6_CTL
.set InputPin__DM0, CYREG_PRT6_DM0
.set InputPin__DM1, CYREG_PRT6_DM1
.set InputPin__DM2, CYREG_PRT6_DM2
.set InputPin__DR, CYREG_PRT6_DR
.set InputPin__INP_DIS, CYREG_PRT6_INP_DIS
.set InputPin__INTSTAT, CYREG_PICU6_INTSTAT
.set InputPin__INTTYPE_BASE, CYDEV_PICU_INTTYPE_PICU6_BASE
.set InputPin__LCD_COM_SEG, CYREG_PRT6_LCD_COM_SEG
.set InputPin__LCD_EN, CYREG_PRT6_LCD_EN
.set InputPin__MASK, 0x02
.set InputPin__PORT, 6
.set InputPin__PRT, CYREG_PRT6_PRT
.set InputPin__PRTDSI__CAPS_SEL, CYREG_PRT6_CAPS_SEL
.set InputPin__PRTDSI__DBL_SYNC_IN, CYREG_PRT6_DBL_SYNC_IN
.set InputPin__PRTDSI__OE_SEL0, CYREG_PRT6_OE_SEL0
.set InputPin__PRTDSI__OE_SEL1, CYREG_PRT6_OE_SEL1
.set InputPin__PRTDSI__OUT_SEL0, CYREG_PRT6_OUT_SEL0
.set InputPin__PRTDSI__OUT_SEL1, CYREG_PRT6_OUT_SEL1
.set InputPin__PRTDSI__SYNC_OUT, CYREG_PRT6_SYNC_OUT
.set InputPin__PS, CYREG_PRT6_PS
.set InputPin__SHIFT, 1
.set InputPin__SLW, CYREG_PRT6_SLW
.set InputPin__SNAP, CYREG_PICU6_SNAP

/* OutputPinHW */
.set OutputPinHW__0__INTTYPE, CYREG_PICU6_INTTYPE2
.set OutputPinHW__0__MASK, 0x04
.set OutputPinHW__0__PC, CYREG_PRT6_PC2
.set OutputPinHW__0__PORT, 6
.set OutputPinHW__0__SHIFT, 2
.set OutputPinHW__AG, CYREG_PRT6_AG
.set OutputPinHW__AMUX, CYREG_PRT6_AMUX
.set OutputPinHW__BIE, CYREG_PRT6_BIE
.set OutputPinHW__BIT_MASK, CYREG_PRT6_BIT_MASK
.set OutputPinHW__BYP, CYREG_PRT6_BYP
.set OutputPinHW__CTL, CYREG_PRT6_CTL
.set OutputPinHW__DM0, CYREG_PRT6_DM0
.set OutputPinHW__DM1, CYREG_PRT6_DM1
.set OutputPinHW__DM2, CYREG_PRT6_DM2
.set OutputPinHW__DR, CYREG_PRT6_DR
.set OutputPinHW__INP_DIS, CYREG_PRT6_INP_DIS
.set OutputPinHW__INTTYPE_BASE, CYDEV_PICU_INTTYPE_PICU6_BASE
.set OutputPinHW__LCD_COM_SEG, CYREG_PRT6_LCD_COM_SEG
.set OutputPinHW__LCD_EN, CYREG_PRT6_LCD_EN
.set OutputPinHW__MASK, 0x04
.set OutputPinHW__PORT, 6
.set OutputPinHW__PRT, CYREG_PRT6_PRT
.set OutputPinHW__PRTDSI__CAPS_SEL, CYREG_PRT6_CAPS_SEL
.set OutputPinHW__PRTDSI__DBL_SYNC_IN, CYREG_PRT6_DBL_SYNC_IN
.set OutputPinHW__PRTDSI__OE_SEL0, CYREG_PRT6_OE_SEL0
.set OutputPinHW__PRTDSI__OE_SEL1, CYREG_PRT6_OE_SEL1
.set OutputPinHW__PRTDSI__OUT_SEL0, CYREG_PRT6_OUT_SEL0
.set OutputPinHW__PRTDSI__OUT_SEL1, CYREG_PRT6_OUT_SEL1
.set OutputPinHW__PRTDSI__SYNC_OUT, CYREG_PRT6_SYNC_OUT
.set OutputPinHW__PS, CYREG_PRT6_PS
.set OutputPinHW__SHIFT, 2
.set OutputPinHW__SLW, CYREG_PRT6_SLW

/* OutputPinSW */
.set OutputPinSW__0__INTTYPE, CYREG_PICU6_INTTYPE3
.set OutputPinSW__0__MASK, 0x08
.set OutputPinSW__0__PC, CYREG_PRT6_PC3
.set OutputPinSW__0__PORT, 6
.set OutputPinSW__0__SHIFT, 3
.set OutputPinSW__AG, CYREG_PRT6_AG
.set OutputPinSW__AMUX, CYREG_PRT6_AMUX
.set OutputPinSW__BIE, CYREG_PRT6_BIE
.set OutputPinSW__BIT_MASK, CYREG_PRT6_BIT_MASK
.set OutputPinSW__BYP, CYREG_PRT6_BYP
.set OutputPinSW__CTL, CYREG_PRT6_CTL
.set OutputPinSW__DM0, CYREG_PRT6_DM0
.set OutputPinSW__DM1, CYREG_PRT6_DM1
.set OutputPinSW__DM2, CYREG_PRT6_DM2
.set OutputPinSW__DR, CYREG_PRT6_DR
.set OutputPinSW__INP_DIS, CYREG_PRT6_INP_DIS
.set OutputPinSW__INTTYPE_BASE, CYDEV_PICU_INTTYPE_PICU6_BASE
.set OutputPinSW__LCD_COM_SEG, CYREG_PRT6_LCD_COM_SEG
.set OutputPinSW__LCD_EN, CYREG_PRT6_LCD_EN
.set OutputPinSW__MASK, 0x08
.set OutputPinSW__PORT, 6
.set OutputPinSW__PRT, CYREG_PRT6_PRT
.set OutputPinSW__PRTDSI__CAPS_SEL, CYREG_PRT6_CAPS_SEL
.set OutputPinSW__PRTDSI__DBL_SYNC_IN, CYREG_PRT6_DBL_SYNC_IN
.set OutputPinSW__PRTDSI__OE_SEL0, CYREG_PRT6_OE_SEL0
.set OutputPinSW__PRTDSI__OE_SEL1, CYREG_PRT6_OE_SEL1
.set OutputPinSW__PRTDSI__OUT_SEL0, CYREG_PRT6_OUT_SEL0
.set OutputPinSW__PRTDSI__OUT_SEL1, CYREG_PRT6_OUT_SEL1
.set OutputPinSW__PRTDSI__SYNC_OUT, CYREG_PRT6_SYNC_OUT
.set OutputPinSW__PS, CYREG_PRT6_PS
.set OutputPinSW__SHIFT, 3
.set OutputPinSW__SLW, CYREG_PRT6_SLW

/* InputInterrupt */
.set InputInterrupt__INTC_CLR_EN_REG, CYREG_NVIC_CLRENA0
.set InputInterrupt__INTC_CLR_PD_REG, CYREG_NVIC_CLRPEND0
.set InputInterrupt__INTC_MASK, 0x400
.set InputInterrupt__INTC_NUMBER, 10
.set InputInterrupt__INTC_PRIOR_NUM, 7
.set InputInterrupt__INTC_PRIOR_REG, CYREG_NVIC_PRI_10
.set InputInterrupt__INTC_SET_EN_REG, CYREG_NVIC_SETENA0
.set InputInterrupt__INTC_SET_PD_REG, CYREG_NVIC_SETPEND0

/* Miscellaneous */
.set BCLK__BUS_CLK__HZ, 24000000
.set BCLK__BUS_CLK__KHZ, 24000
.set BCLK__BUS_CLK__MHZ, 24
.set CYDEV_CHIP_DIE_LEOPARD, 1
.set CYDEV_CHIP_DIE_PSOC4A, 26
.set CYDEV_CHIP_DIE_PSOC5LP, 2
.set CYDEV_CHIP_DIE_PSOC5TM, 3
.set CYDEV_CHIP_DIE_TMA4, 4
.set CYDEV_CHIP_DIE_UNKNOWN, 0
.set CYDEV_CHIP_FAMILY_FM0P, 5
.set CYDEV_CHIP_FAMILY_FM3, 6
.set CYDEV_CHIP_FAMILY_FM4, 7
.set CYDEV_CHIP_FAMILY_PSOC3, 1
.set CYDEV_CHIP_FAMILY_PSOC4, 2
.set CYDEV_CHIP_FAMILY_PSOC5, 3
.set CYDEV_CHIP_FAMILY_PSOC6, 4
.set CYDEV_CHIP_FAMILY_UNKNOWN, 0
.set CYDEV_CHIP_FAMILY_USED, CYDEV_CHIP_FAMILY_PSOC5
.set CYDEV_CHIP_JTAG_ID, 0x2E123069
.set CYDEV_CHIP_MEMBER_3A, 1
.set CYDEV_CHIP_MEMBER_4A, 26
.set CYDEV_CHIP_MEMBER_4AA, 25
.set CYDEV_CHIP_MEMBER_4AB, 30
.set CYDEV_CHIP_MEMBER_4AC, 14
.set CYDEV_CHIP_MEMBER_4AD, 15
.set CYDEV_CHIP_MEMBER_4AE, 16
.set CYDEV_CHIP_MEMBER_4D, 20
.set CYDEV_CHIP_MEMBER_4E, 6
.set CYDEV_CHIP_MEMBER_4F, 27
.set CYDEV_CHIP_MEMBER_4G, 4
.set CYDEV_CHIP_MEMBER_4H, 24
.set CYDEV_CHIP_MEMBER_4I, 32
.set CYDEV_CHIP_MEMBER_4J, 21
.set CYDEV_CHIP_MEMBER_4K, 22
.set CYDEV_CHIP_MEMBER_4L, 31
.set CYDEV_CHIP_MEMBER_4M, 29
.set CYDEV_CHIP_MEMBER_4N, 11
.set CYDEV_CHIP_MEMBER_4O, 8
.set CYDEV_CHIP_MEMBER_4P, 28
.set CYDEV_CHIP_MEMBER_4Q, 17
.set CYDEV_CHIP_MEMBER_4R, 9
.set CYDEV_CHIP_MEMBER_4S, 12
.set CYDEV_CHIP_MEMBER_4T, 10
.set CYDEV_CHIP_MEMBER_4U, 5
.set CYDEV_CHIP_MEMBER_4V, 23
.set CYDEV_CHIP_MEMBER_4W, 13
.set CYDEV_CHIP_MEMBER_4X, 7
.set CYDEV_CHIP_MEMBER_4Y, 18
.set CYDEV_CHIP_MEMBER_4Z, 19
.set CYDEV_CHIP_MEMBER_5A, 3
.set CYDEV_CHIP_MEMBER_5B, 2
.set CYDEV_CHIP_MEMBER_6A, 33
.set CYDEV_CHIP_MEMBER_FM3, 37
.set CYDEV_CHIP_MEMBER_FM4, 38
.set CYDEV_CHIP_MEMBER_PDL_FM0P_TYPE1, 34
.set CYDEV_CHIP_MEMBER_PDL_FM0P_TYPE2, 35
.set CYDEV_CHIP_MEMBER_PDL_FM0P_TYPE3, 36
.set CYDEV_CHIP_MEMBER_UNKNOWN, 0
.set CYDEV_CHIP_MEMBER_USED, CYDEV_CHIP_MEMBER_5B
.set CYDEV_CHIP_DIE_EXPECT, CYDEV_CHIP_MEMBER_USED
.set CYDEV_CHIP_DIE_ACTUAL, CYDEV_CHIP_DIE_EXPECT
.set CYDEV_CHIP_REV_LEOPARD_ES1, 0
.set CYDEV_CHIP_REV_LEOPARD_ES2, 1
.set CYDEV_CHIP_REV_LEOPARD_ES3, 3
.set CYDEV_CHIP_REV_LEOPARD_PRODUCTION, 3
.set CYDEV_CHIP_REV_PSOC4A_ES0, 17
.set CYDEV_CHIP_REV_PSOC4A_PRODUCTION, 17
.set CYDEV_CHIP_REV_PSOC5LP_ES0, 0
.set CYDEV_CHIP_REV_PSOC5LP_PRODUCTION, 0
.set CYDEV_CHIP_REV_PSOC5TM_ES0, 0
.set CYDEV_CHIP_REV_PSOC5TM_ES1, 1
.set CYDEV_CHIP_REV_PSOC5TM_PRODUCTION, 1
.set CYDEV_CHIP_REV_TMA4_ES, 17
.set CYDEV_CHIP_REV_TMA4_ES2, 33
.set CYDEV_CHIP_REV_TMA4_PRODUCTION, 17
.set CYDEV_CHIP_REVISION_3A_ES1, 0
.set CYDEV_CHIP_REVISION_3A_ES2, 1
.set CYDEV_CHIP_REVISION_3A_ES3, 3
.set CYDEV_CHIP_REVISION_3A_PRODUCTION, 3
.set CYDEV_CHIP_REVISION_4A_ES0, 17
.set CYDEV_CHIP_REVISION_4A_PRODUCTION, 17
.set CYDEV_CHIP_REVISION_4AA_PRODUCTION, 0
.set CYDEV_CHIP_REVISION_4AB_PRODUCTION, 0
.set CYDEV_CHIP_REVISION_4AC_PRODUCTION, 0
.set CYDEV_CHIP_REVISION_4AD_PRODUCTION, 0
.set CYDEV_CHIP_REVISION_4AE_PRODUCTION, 0
.set CYDEV_CHIP_REVISION_4D_PRODUCTION, 0
.set CYDEV_CHIP_REVISION_4E_CCG2_NO_USBPD, 0
.set CYDEV_CHIP_REVISION_4E_PRODUCTION, 0
.set CYDEV_CHIP_REVISION_4F_PRODUCTION, 0
.set CYDEV_CHIP_REVISION_4F_PRODUCTION_256DMA, 0
.set CYDEV_CHIP_REVISION_4F_PRODUCTION_256K, 0
.set CYDEV_CHIP_REVISION_4G_ES, 17
.set CYDEV_CHIP_REVISION_4G_ES2, 33
.set CYDEV_CHIP_REVISION_4G_PRODUCTION, 17
.set CYDEV_CHIP_REVISION_4H_PRODUCTION, 0
.set CYDEV_CHIP_REVISION_4I_PRODUCTION, 0
.set CYDEV_CHIP_REVISION_4J_PRODUCTION, 0
.set CYDEV_CHIP_REVISION_4K_PRODUCTION, 0
.set CYDEV_CHIP_REVISION_4L_PRODUCTION, 0
.set CYDEV_CHIP_REVISION_4M_PRODUCTION, 0
.set CYDEV_CHIP_REVISION_4N_PRODUCTION, 0
.set CYDEV_CHIP_REVISION_4O_PRODUCTION, 0
.set CYDEV_CHIP_REVISION_4P_PRODUCTION, 0
.set CYDEV_CHIP_REVISION_4Q_PRODUCTION, 0
.set CYDEV_CHIP_REVISION_4R_PRODUCTION, 0
.set CYDEV_CHIP_REVISION_4S_PRODUCTION, 0
.set CYDEV_CHIP_REVISION_4T_PRODUCTION, 0
.set CYDEV_CHIP_REVISION_4U_PRODUCTION, 0
.set CYDEV_CHIP_REVISION_4V_PRODUCTION, 0
.set CYDEV_CHIP_REVISION_4W_PRODUCTION, 0
.set CYDEV_CHIP_REVISION_4X_PRODUCTION, 0
.set CYDEV_CHIP_REVISION_4Y_PRODUCTION, 0
.set CYDEV_CHIP_REVISION_4Z_PRODUCTION, 0
.set CYDEV_CHIP_REVISION_5A_ES0, 0
.set CYDEV_CHIP_REVISION_5A_ES1, 1
.set CYDEV_CHIP_REVISION_5A_PRODUCTION, 1
.set CYDEV_CHIP_REVISION_5B_ES0, 0
.set CYDEV_CHIP_REVISION_5B_PRODUCTION, 0
.set CYDEV_CHIP_REVISION_6A_ES, 17
.set CYDEV_CHIP_REVISION_6A_NO_UDB, 33
.set CYDEV_CHIP_REVISION_6A_PRODUCTION, 33
.set CYDEV_CHIP_REVISION_FM3_PRODUCTION, 0
.set CYDEV_CHIP_REVISION_FM4_PRODUCTION, 0
.set CYDEV_CHIP_REVISION_PDL_FM0P_TYPE1_PRODUCTION, 0
.set CYDEV_CHIP_REVISION_PDL_FM0P_TYPE2_PRODUCTION, 0
.set CYDEV_CHIP_REVISION_PDL_FM0P_TYPE3_PRODUCTION, 0
.set CYDEV_CHIP_REVISION_USED, CYDEV_CHIP_REVISION_5B_PRODUCTION
.set CYDEV_CHIP_REV_EXPECT, CYDEV_CHIP_REVISION_USED
.set CYDEV_CONFIG_FASTBOOT_ENABLED, 1
.set CYDEV_CONFIG_UNUSED_IO_AllowButWarn, 0
.set CYDEV_CONFIG_UNUSED_IO, CYDEV_CONFIG_UNUSED_IO_AllowButWarn
.set CYDEV_CONFIG_UNUSED_IO_AllowWithInfo, 1
.set CYDEV_CONFIG_UNUSED_IO_Disallowed, 2
.set CYDEV_CONFIGURATION_COMPRESSED, 1
.set CYDEV_CONFIGURATION_DMA, 0
.set CYDEV_CONFIGURATION_ECC, 1
.set CYDEV_CONFIGURATION_IMOENABLED, CYDEV_CONFIG_FASTBOOT_ENABLED
.set CYDEV_CONFIGURATION_MODE_COMPRESSED, 0
.set CYDEV_CONFIGURATION_MODE, CYDEV_CONFIGURATION_MODE_COMPRESSED
.set CYDEV_CONFIGURATION_MODE_DMA, 2
.set CYDEV_CONFIGURATION_MODE_UNCOMPRESSED, 1
.set CYDEV_DEBUG_ENABLE_MASK, 0x20
.set CYDEV_DEBUG_ENABLE_REGISTER, CYREG_MLOGIC_DEBUG
.set CYDEV_DEBUGGING_DPS_Disable, 3
.set CYDEV_DEBUGGING_DPS_JTAG_4, 1
.set CYDEV_DEBUGGING_DPS_JTAG_5, 0
.set CYDEV_DEBUGGING_DPS_SWD, 2
.set CYDEV_DEBUGGING_DPS, CYDEV_DEBUGGING_DPS_SWD
.set CYDEV_DEBUGGING_DPS_SWD_SWV, 6
.set CYDEV_DEBUGGING_ENABLE, 1
.set CYDEV_DEBUGGING_XRES, 0
.set CYDEV_DMA_CHANNELS_AVAILABLE, 24
.set CYDEV_ECC_ENABLE, 0
.set CYDEV_HEAP_SIZE, 0x0080
.set CYDEV_INSTRUCT_CACHE_ENABLED, 1
.set CYDEV_INTR_RISING, 0x00000000
.set CYDEV_IS_EXPORTING_CODE, 0
.set CYDEV_IS_IMPORTING_CODE, 0
.set CYDEV_PROJ_TYPE, 0
.set CYDEV_PROJ_TYPE_BOOTLOADER, 1
.set CYDEV_PROJ_TYPE_LAUNCHER, 5
.set CYDEV_PROJ_TYPE_LOADABLE, 2
.set CYDEV_PROJ_TYPE_LOADABLEANDBOOTLOADER, 4
.set CYDEV_PROJ_TYPE_MULTIAPPBOOTLOADER, 3
.set CYDEV_PROJ_TYPE_STANDARD, 0
.set CYDEV_PROTECTION_ENABLE, 0
.set CYDEV_STACK_SIZE, 0x0200
.set CYDEV_USE_BUNDLED_CMSIS, 1
.set CYDEV_VARIABLE_VDDA, 1
.set CYDEV_VDDA_MV, 3300
.set CYDEV_VDDD_MV, 3300
.set CYDEV_VDDIO0_MV, 3300
.set CYDEV_VDDIO1_MV, 3300
.set CYDEV_VDDIO2_MV, 3300
.set CYDEV_VDDIO3_MV, 3300
.set CYDEV_VIO0_MV, 3300
.set CYDEV_VIO1_MV, 3300
.set CYDEV_VIO2_MV, 3300
.set CYDEV_VIO3_MV, 3300
.set CYIPBLOCK_ARM_CM3_VERSION, 0
.set CYIPBLOCK_P3_ANAIF_VERSION, 0
.set CYIPBLOCK_P3_CAN_VERSION, 0
.set CYIPBLOCK_P3_CAPSENSE_VERSION, 0
.set CYIPBLOCK_P3_COMP_VERSION, 0
.set CYIPBLOCK_P3_DECIMATOR_VERSION, 0
.set CYIPBLOCK_P3_DFB_VERSION, 0
.set CYIPBLOCK_P3_DMA_VERSION, 0
.set CYIPBLOCK_P3_DRQ_VERSION, 0
.set CYIPBLOCK_P3_DSM_VERSION, 0
.set CYIPBLOCK_P3_EMIF_VERSION, 0
.set CYIPBLOCK_P3_I2C_VERSION, 0
.set CYIPBLOCK_P3_LCD_VERSION, 0
.set CYIPBLOCK_P3_LPF_VERSION, 0
.set CYIPBLOCK_P3_OPAMP_VERSION, 0
.set CYIPBLOCK_P3_PM_VERSION, 0
.set CYIPBLOCK_P3_SCCT_VERSION, 0
.set CYIPBLOCK_P3_TIMER_VERSION, 0
.set CYIPBLOCK_P3_USB_VERSION, 0
.set CYIPBLOCK_P3_VIDAC_VERSION, 0
.set CYIPBLOCK_P3_VREF_VERSION, 0
.set CYIPBLOCK_S8_GPIO_VERSION, 0
.set CYIPBLOCK_S8_IRQ_VERSION, 0
.set CYIPBLOCK_S8_SAR_VERSION, 0
.set CYIPBLOCK_S8_SIO_VERSION, 0
.set CYIPBLOCK_S8_UDB_VERSION, 0
.set CyScBoostClk__CFG0, CYREG_CLKDIST_ACFG0_CFG0
.set CyScBoostClk__CFG1, CYREG_CLKDIST_ACFG0_CFG1
.set CyScBoostClk__CFG2, CYREG_CLKDIST_ACFG0_CFG2
.set CyScBoostClk__CFG2_SRC_SEL_MASK, 0x07
.set CyScBoostClk__CFG3, CYREG_CLKDIST_ACFG0_CFG3
.set CyScBoostClk__CFG3_PHASE_DLY_MASK, 0x0F
.set CyScBoostClk__INDEX, 0x00
.set CyScBoostClk__PM_ACT_CFG, CYREG_PM_ACT_CFG1
.set CyScBoostClk__PM_ACT_MSK, 0x01
.set CyScBoostClk__PM_STBY_CFG, CYREG_PM_STBY_CFG1
.set CyScBoostClk__PM_STBY_MSK, 0x01
.set DMA_CHANNELS_USED__MASK0, 0x00000000
.set CYDEV_BOOTLOADER_ENABLE, 0
.endif
