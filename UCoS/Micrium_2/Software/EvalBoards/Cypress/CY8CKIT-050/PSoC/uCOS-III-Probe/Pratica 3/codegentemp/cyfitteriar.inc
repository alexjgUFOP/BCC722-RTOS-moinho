;
; File Name: cyfitteriar.inc
; 
; PSoC Creator  4.4
;
; Description:
; 
;
;-------------------------------------------------------------------------------
; Copyright (c) 2007-2020 Cypress Semiconductor.  All rights reserved.
; You may use this file only in accordance with the license, terms, conditions, 
; disclaimers, and limitations in the end user license agreement accompanying 
; the software package with which this file was provided.
;-------------------------------------------------------------------------------

#ifndef INCLUDED_CYFITTERIAR_INC
#define INCLUDED_CYFITTERIAR_INC
    INCLUDE cydeviceiar.inc
    INCLUDE cydeviceiar_trm.inc

/* LED */
LED__0__INTTYPE EQU CYREG_PICU6_INTTYPE2
LED__0__MASK EQU 0x04
LED__0__PC EQU CYREG_PRT6_PC2
LED__0__PORT EQU 6
LED__0__SHIFT EQU 2
LED__1__INTTYPE EQU CYREG_PICU6_INTTYPE3
LED__1__MASK EQU 0x08
LED__1__PC EQU CYREG_PRT6_PC3
LED__1__PORT EQU 6
LED__1__SHIFT EQU 3
LED__AG EQU CYREG_PRT6_AG
LED__AMUX EQU CYREG_PRT6_AMUX
LED__BIE EQU CYREG_PRT6_BIE
LED__BIT_MASK EQU CYREG_PRT6_BIT_MASK
LED__BYP EQU CYREG_PRT6_BYP
LED__CTL EQU CYREG_PRT6_CTL
LED__DM0 EQU CYREG_PRT6_DM0
LED__DM1 EQU CYREG_PRT6_DM1
LED__DM2 EQU CYREG_PRT6_DM2
LED__DR EQU CYREG_PRT6_DR
LED__INP_DIS EQU CYREG_PRT6_INP_DIS
LED__INTTYPE_BASE EQU CYDEV_PICU_INTTYPE_PICU6_BASE
LED__LCD_COM_SEG EQU CYREG_PRT6_LCD_COM_SEG
LED__LCD_EN EQU CYREG_PRT6_LCD_EN
LED__MASK EQU 0x0C
LED__PORT EQU 6
LED__PRT EQU CYREG_PRT6_PRT
LED__PRTDSI__CAPS_SEL EQU CYREG_PRT6_CAPS_SEL
LED__PRTDSI__DBL_SYNC_IN EQU CYREG_PRT6_DBL_SYNC_IN
LED__PRTDSI__OE_SEL0 EQU CYREG_PRT6_OE_SEL0
LED__PRTDSI__OE_SEL1 EQU CYREG_PRT6_OE_SEL1
LED__PRTDSI__OUT_SEL0 EQU CYREG_PRT6_OUT_SEL0
LED__PRTDSI__OUT_SEL1 EQU CYREG_PRT6_OUT_SEL1
LED__PRTDSI__SYNC_OUT EQU CYREG_PRT6_SYNC_OUT
LED__PS EQU CYREG_PRT6_PS
LED__SHIFT EQU 2
LED__SLW EQU CYREG_PRT6_SLW
LED_Status_Sync_ctrl_reg__0__MASK EQU 0x01
LED_Status_Sync_ctrl_reg__0__POS EQU 0
LED_Status_Sync_ctrl_reg__1__MASK EQU 0x02
LED_Status_Sync_ctrl_reg__1__POS EQU 1
LED_Status_Sync_ctrl_reg__16BIT_CONTROL_AUX_CTL_REG EQU CYREG_B0_UDB05_06_ACTL
LED_Status_Sync_ctrl_reg__16BIT_CONTROL_CONTROL_REG EQU CYREG_B0_UDB05_06_CTL
LED_Status_Sync_ctrl_reg__16BIT_CONTROL_COUNT_REG EQU CYREG_B0_UDB05_06_CTL
LED_Status_Sync_ctrl_reg__16BIT_COUNT_CONTROL_REG EQU CYREG_B0_UDB05_06_CTL
LED_Status_Sync_ctrl_reg__16BIT_COUNT_COUNT_REG EQU CYREG_B0_UDB05_06_CTL
LED_Status_Sync_ctrl_reg__16BIT_MASK_MASK_REG EQU CYREG_B0_UDB05_06_MSK
LED_Status_Sync_ctrl_reg__16BIT_MASK_PERIOD_REG EQU CYREG_B0_UDB05_06_MSK
LED_Status_Sync_ctrl_reg__16BIT_PERIOD_MASK_REG EQU CYREG_B0_UDB05_06_MSK
LED_Status_Sync_ctrl_reg__16BIT_PERIOD_PERIOD_REG EQU CYREG_B0_UDB05_06_MSK
LED_Status_Sync_ctrl_reg__CONTROL_AUX_CTL_REG EQU CYREG_B0_UDB05_ACTL
LED_Status_Sync_ctrl_reg__CONTROL_REG EQU CYREG_B0_UDB05_CTL
LED_Status_Sync_ctrl_reg__CONTROL_ST_REG EQU CYREG_B0_UDB05_ST_CTL
LED_Status_Sync_ctrl_reg__COUNT_REG EQU CYREG_B0_UDB05_CTL
LED_Status_Sync_ctrl_reg__COUNT_ST_REG EQU CYREG_B0_UDB05_ST_CTL
LED_Status_Sync_ctrl_reg__MASK EQU 0x03
LED_Status_Sync_ctrl_reg__MASK_CTL_AUX_CTL_REG EQU CYREG_B0_UDB05_MSK_ACTL
LED_Status_Sync_ctrl_reg__PER_CTL_AUX_CTL_REG EQU CYREG_B0_UDB05_MSK_ACTL
LED_Status_Sync_ctrl_reg__PERIOD_REG EQU CYREG_B0_UDB05_MSK

/* PB_2 */
PB_2__0__INTTYPE EQU CYREG_PICU6_INTTYPE1
PB_2__0__MASK EQU 0x02
PB_2__0__PC EQU CYREG_PRT6_PC1
PB_2__0__PORT EQU 6
PB_2__0__SHIFT EQU 1
PB_2__AG EQU CYREG_PRT6_AG
PB_2__AMUX EQU CYREG_PRT6_AMUX
PB_2__BIE EQU CYREG_PRT6_BIE
PB_2__BIT_MASK EQU CYREG_PRT6_BIT_MASK
PB_2__BYP EQU CYREG_PRT6_BYP
PB_2__CTL EQU CYREG_PRT6_CTL
PB_2__DM0 EQU CYREG_PRT6_DM0
PB_2__DM1 EQU CYREG_PRT6_DM1
PB_2__DM2 EQU CYREG_PRT6_DM2
PB_2__DR EQU CYREG_PRT6_DR
PB_2__INP_DIS EQU CYREG_PRT6_INP_DIS
PB_2__INTTYPE_BASE EQU CYDEV_PICU_INTTYPE_PICU6_BASE
PB_2__LCD_COM_SEG EQU CYREG_PRT6_LCD_COM_SEG
PB_2__LCD_EN EQU CYREG_PRT6_LCD_EN
PB_2__MASK EQU 0x02
PB_2__PORT EQU 6
PB_2__PRT EQU CYREG_PRT6_PRT
PB_2__PRTDSI__CAPS_SEL EQU CYREG_PRT6_CAPS_SEL
PB_2__PRTDSI__DBL_SYNC_IN EQU CYREG_PRT6_DBL_SYNC_IN
PB_2__PRTDSI__OE_SEL0 EQU CYREG_PRT6_OE_SEL0
PB_2__PRTDSI__OE_SEL1 EQU CYREG_PRT6_OE_SEL1
PB_2__PRTDSI__OUT_SEL0 EQU CYREG_PRT6_OUT_SEL0
PB_2__PRTDSI__OUT_SEL1 EQU CYREG_PRT6_OUT_SEL1
PB_2__PRTDSI__SYNC_OUT EQU CYREG_PRT6_SYNC_OUT
PB_2__PS EQU CYREG_PRT6_PS
PB_2__SHIFT EQU 1
PB_2__SLW EQU CYREG_PRT6_SLW

/* PB_3 */
PB_3__0__INTTYPE EQU CYREG_PICU15_INTTYPE5
PB_3__0__MASK EQU 0x20
PB_3__0__PC EQU CYREG_IO_PC_PRT15_PC5
PB_3__0__PORT EQU 15
PB_3__0__SHIFT EQU 5
PB_3__AG EQU CYREG_PRT15_AG
PB_3__AMUX EQU CYREG_PRT15_AMUX
PB_3__BIE EQU CYREG_PRT15_BIE
PB_3__BIT_MASK EQU CYREG_PRT15_BIT_MASK
PB_3__BYP EQU CYREG_PRT15_BYP
PB_3__CTL EQU CYREG_PRT15_CTL
PB_3__DM0 EQU CYREG_PRT15_DM0
PB_3__DM1 EQU CYREG_PRT15_DM1
PB_3__DM2 EQU CYREG_PRT15_DM2
PB_3__DR EQU CYREG_PRT15_DR
PB_3__INP_DIS EQU CYREG_PRT15_INP_DIS
PB_3__INTTYPE_BASE EQU CYDEV_PICU_INTTYPE_PICU15_BASE
PB_3__LCD_COM_SEG EQU CYREG_PRT15_LCD_COM_SEG
PB_3__LCD_EN EQU CYREG_PRT15_LCD_EN
PB_3__MASK EQU 0x20
PB_3__PORT EQU 15
PB_3__PRT EQU CYREG_PRT15_PRT
PB_3__PRTDSI__CAPS_SEL EQU CYREG_PRT15_CAPS_SEL
PB_3__PRTDSI__DBL_SYNC_IN EQU CYREG_PRT15_DBL_SYNC_IN
PB_3__PRTDSI__OE_SEL0 EQU CYREG_PRT15_OE_SEL0
PB_3__PRTDSI__OE_SEL1 EQU CYREG_PRT15_OE_SEL1
PB_3__PRTDSI__OUT_SEL0 EQU CYREG_PRT15_OUT_SEL0
PB_3__PRTDSI__OUT_SEL1 EQU CYREG_PRT15_OUT_SEL1
PB_3__PRTDSI__SYNC_OUT EQU CYREG_PRT15_SYNC_OUT
PB_3__PS EQU CYREG_PRT15_PS
PB_3__SHIFT EQU 5
PB_3__SLW EQU CYREG_PRT15_SLW

/* LCD_Disp */
LCD_Disp_LCDPort__0__INTTYPE EQU CYREG_PICU2_INTTYPE0
LCD_Disp_LCDPort__0__MASK EQU 0x01
LCD_Disp_LCDPort__0__PC EQU CYREG_PRT2_PC0
LCD_Disp_LCDPort__0__PORT EQU 2
LCD_Disp_LCDPort__0__SHIFT EQU 0
LCD_Disp_LCDPort__1__INTTYPE EQU CYREG_PICU2_INTTYPE1
LCD_Disp_LCDPort__1__MASK EQU 0x02
LCD_Disp_LCDPort__1__PC EQU CYREG_PRT2_PC1
LCD_Disp_LCDPort__1__PORT EQU 2
LCD_Disp_LCDPort__1__SHIFT EQU 1
LCD_Disp_LCDPort__2__INTTYPE EQU CYREG_PICU2_INTTYPE2
LCD_Disp_LCDPort__2__MASK EQU 0x04
LCD_Disp_LCDPort__2__PC EQU CYREG_PRT2_PC2
LCD_Disp_LCDPort__2__PORT EQU 2
LCD_Disp_LCDPort__2__SHIFT EQU 2
LCD_Disp_LCDPort__3__INTTYPE EQU CYREG_PICU2_INTTYPE3
LCD_Disp_LCDPort__3__MASK EQU 0x08
LCD_Disp_LCDPort__3__PC EQU CYREG_PRT2_PC3
LCD_Disp_LCDPort__3__PORT EQU 2
LCD_Disp_LCDPort__3__SHIFT EQU 3
LCD_Disp_LCDPort__4__INTTYPE EQU CYREG_PICU2_INTTYPE4
LCD_Disp_LCDPort__4__MASK EQU 0x10
LCD_Disp_LCDPort__4__PC EQU CYREG_PRT2_PC4
LCD_Disp_LCDPort__4__PORT EQU 2
LCD_Disp_LCDPort__4__SHIFT EQU 4
LCD_Disp_LCDPort__5__INTTYPE EQU CYREG_PICU2_INTTYPE5
LCD_Disp_LCDPort__5__MASK EQU 0x20
LCD_Disp_LCDPort__5__PC EQU CYREG_PRT2_PC5
LCD_Disp_LCDPort__5__PORT EQU 2
LCD_Disp_LCDPort__5__SHIFT EQU 5
LCD_Disp_LCDPort__6__INTTYPE EQU CYREG_PICU2_INTTYPE6
LCD_Disp_LCDPort__6__MASK EQU 0x40
LCD_Disp_LCDPort__6__PC EQU CYREG_PRT2_PC6
LCD_Disp_LCDPort__6__PORT EQU 2
LCD_Disp_LCDPort__6__SHIFT EQU 6
LCD_Disp_LCDPort__AG EQU CYREG_PRT2_AG
LCD_Disp_LCDPort__AMUX EQU CYREG_PRT2_AMUX
LCD_Disp_LCDPort__BIE EQU CYREG_PRT2_BIE
LCD_Disp_LCDPort__BIT_MASK EQU CYREG_PRT2_BIT_MASK
LCD_Disp_LCDPort__BYP EQU CYREG_PRT2_BYP
LCD_Disp_LCDPort__CTL EQU CYREG_PRT2_CTL
LCD_Disp_LCDPort__DM0 EQU CYREG_PRT2_DM0
LCD_Disp_LCDPort__DM1 EQU CYREG_PRT2_DM1
LCD_Disp_LCDPort__DM2 EQU CYREG_PRT2_DM2
LCD_Disp_LCDPort__DR EQU CYREG_PRT2_DR
LCD_Disp_LCDPort__INP_DIS EQU CYREG_PRT2_INP_DIS
LCD_Disp_LCDPort__INTTYPE_BASE EQU CYDEV_PICU_INTTYPE_PICU2_BASE
LCD_Disp_LCDPort__LCD_COM_SEG EQU CYREG_PRT2_LCD_COM_SEG
LCD_Disp_LCDPort__LCD_EN EQU CYREG_PRT2_LCD_EN
LCD_Disp_LCDPort__MASK EQU 0x7F
LCD_Disp_LCDPort__PORT EQU 2
LCD_Disp_LCDPort__PRT EQU CYREG_PRT2_PRT
LCD_Disp_LCDPort__PRTDSI__CAPS_SEL EQU CYREG_PRT2_CAPS_SEL
LCD_Disp_LCDPort__PRTDSI__DBL_SYNC_IN EQU CYREG_PRT2_DBL_SYNC_IN
LCD_Disp_LCDPort__PRTDSI__OE_SEL0 EQU CYREG_PRT2_OE_SEL0
LCD_Disp_LCDPort__PRTDSI__OE_SEL1 EQU CYREG_PRT2_OE_SEL1
LCD_Disp_LCDPort__PRTDSI__OUT_SEL0 EQU CYREG_PRT2_OUT_SEL0
LCD_Disp_LCDPort__PRTDSI__OUT_SEL1 EQU CYREG_PRT2_OUT_SEL1
LCD_Disp_LCDPort__PRTDSI__SYNC_OUT EQU CYREG_PRT2_SYNC_OUT
LCD_Disp_LCDPort__PS EQU CYREG_PRT2_PS
LCD_Disp_LCDPort__SHIFT EQU 0
LCD_Disp_LCDPort__SLW EQU CYREG_PRT2_SLW

/* ProbeUART */
ProbeUART_BUART_sRX_RxBitCounter__16BIT_CONTROL_AUX_CTL_REG EQU CYREG_B0_UDB01_02_ACTL
ProbeUART_BUART_sRX_RxBitCounter__16BIT_CONTROL_CONTROL_REG EQU CYREG_B0_UDB01_02_CTL
ProbeUART_BUART_sRX_RxBitCounter__16BIT_CONTROL_COUNT_REG EQU CYREG_B0_UDB01_02_CTL
ProbeUART_BUART_sRX_RxBitCounter__16BIT_COUNT_CONTROL_REG EQU CYREG_B0_UDB01_02_CTL
ProbeUART_BUART_sRX_RxBitCounter__16BIT_COUNT_COUNT_REG EQU CYREG_B0_UDB01_02_CTL
ProbeUART_BUART_sRX_RxBitCounter__16BIT_MASK_MASK_REG EQU CYREG_B0_UDB01_02_MSK
ProbeUART_BUART_sRX_RxBitCounter__16BIT_MASK_PERIOD_REG EQU CYREG_B0_UDB01_02_MSK
ProbeUART_BUART_sRX_RxBitCounter__16BIT_PERIOD_MASK_REG EQU CYREG_B0_UDB01_02_MSK
ProbeUART_BUART_sRX_RxBitCounter__16BIT_PERIOD_PERIOD_REG EQU CYREG_B0_UDB01_02_MSK
ProbeUART_BUART_sRX_RxBitCounter__CONTROL_AUX_CTL_REG EQU CYREG_B0_UDB01_ACTL
ProbeUART_BUART_sRX_RxBitCounter__CONTROL_REG EQU CYREG_B0_UDB01_CTL
ProbeUART_BUART_sRX_RxBitCounter__CONTROL_ST_REG EQU CYREG_B0_UDB01_ST_CTL
ProbeUART_BUART_sRX_RxBitCounter__COUNT_REG EQU CYREG_B0_UDB01_CTL
ProbeUART_BUART_sRX_RxBitCounter__COUNT_ST_REG EQU CYREG_B0_UDB01_ST_CTL
ProbeUART_BUART_sRX_RxBitCounter__MASK_CTL_AUX_CTL_REG EQU CYREG_B0_UDB01_MSK_ACTL
ProbeUART_BUART_sRX_RxBitCounter__PER_CTL_AUX_CTL_REG EQU CYREG_B0_UDB01_MSK_ACTL
ProbeUART_BUART_sRX_RxBitCounter__PERIOD_REG EQU CYREG_B0_UDB01_MSK
ProbeUART_BUART_sRX_RxBitCounter_ST__16BIT_STATUS_AUX_CTL_REG EQU CYREG_B0_UDB01_02_ACTL
ProbeUART_BUART_sRX_RxBitCounter_ST__16BIT_STATUS_REG EQU CYREG_B0_UDB01_02_ST
ProbeUART_BUART_sRX_RxBitCounter_ST__MASK_REG EQU CYREG_B0_UDB01_MSK
ProbeUART_BUART_sRX_RxBitCounter_ST__MASK_ST_AUX_CTL_REG EQU CYREG_B0_UDB01_MSK_ACTL
ProbeUART_BUART_sRX_RxBitCounter_ST__PER_ST_AUX_CTL_REG EQU CYREG_B0_UDB01_MSK_ACTL
ProbeUART_BUART_sRX_RxBitCounter_ST__STATUS_AUX_CTL_REG EQU CYREG_B0_UDB01_ACTL
ProbeUART_BUART_sRX_RxBitCounter_ST__STATUS_CNT_REG EQU CYREG_B0_UDB01_ST_CTL
ProbeUART_BUART_sRX_RxBitCounter_ST__STATUS_CONTROL_REG EQU CYREG_B0_UDB01_ST_CTL
ProbeUART_BUART_sRX_RxBitCounter_ST__STATUS_REG EQU CYREG_B0_UDB01_ST
ProbeUART_BUART_sRX_RxShifter_u0__16BIT_A0_REG EQU CYREG_B0_UDB01_02_A0
ProbeUART_BUART_sRX_RxShifter_u0__16BIT_A1_REG EQU CYREG_B0_UDB01_02_A1
ProbeUART_BUART_sRX_RxShifter_u0__16BIT_D0_REG EQU CYREG_B0_UDB01_02_D0
ProbeUART_BUART_sRX_RxShifter_u0__16BIT_D1_REG EQU CYREG_B0_UDB01_02_D1
ProbeUART_BUART_sRX_RxShifter_u0__16BIT_DP_AUX_CTL_REG EQU CYREG_B0_UDB01_02_ACTL
ProbeUART_BUART_sRX_RxShifter_u0__16BIT_F0_REG EQU CYREG_B0_UDB01_02_F0
ProbeUART_BUART_sRX_RxShifter_u0__16BIT_F1_REG EQU CYREG_B0_UDB01_02_F1
ProbeUART_BUART_sRX_RxShifter_u0__A0_A1_REG EQU CYREG_B0_UDB01_A0_A1
ProbeUART_BUART_sRX_RxShifter_u0__A0_REG EQU CYREG_B0_UDB01_A0
ProbeUART_BUART_sRX_RxShifter_u0__A1_REG EQU CYREG_B0_UDB01_A1
ProbeUART_BUART_sRX_RxShifter_u0__D0_D1_REG EQU CYREG_B0_UDB01_D0_D1
ProbeUART_BUART_sRX_RxShifter_u0__D0_REG EQU CYREG_B0_UDB01_D0
ProbeUART_BUART_sRX_RxShifter_u0__D1_REG EQU CYREG_B0_UDB01_D1
ProbeUART_BUART_sRX_RxShifter_u0__DP_AUX_CTL_REG EQU CYREG_B0_UDB01_ACTL
ProbeUART_BUART_sRX_RxShifter_u0__F0_F1_REG EQU CYREG_B0_UDB01_F0_F1
ProbeUART_BUART_sRX_RxShifter_u0__F0_REG EQU CYREG_B0_UDB01_F0
ProbeUART_BUART_sRX_RxShifter_u0__F1_REG EQU CYREG_B0_UDB01_F1
ProbeUART_BUART_sRX_RxShifter_u0__MSK_DP_AUX_CTL_REG EQU CYREG_B0_UDB01_MSK_ACTL
ProbeUART_BUART_sRX_RxShifter_u0__PER_DP_AUX_CTL_REG EQU CYREG_B0_UDB01_MSK_ACTL
ProbeUART_BUART_sRX_RxSts__16BIT_STATUS_AUX_CTL_REG EQU CYREG_B0_UDB03_04_ACTL
ProbeUART_BUART_sRX_RxSts__16BIT_STATUS_REG EQU CYREG_B0_UDB03_04_ST
ProbeUART_BUART_sRX_RxSts__3__MASK EQU 0x08
ProbeUART_BUART_sRX_RxSts__3__POS EQU 3
ProbeUART_BUART_sRX_RxSts__4__MASK EQU 0x10
ProbeUART_BUART_sRX_RxSts__4__POS EQU 4
ProbeUART_BUART_sRX_RxSts__5__MASK EQU 0x20
ProbeUART_BUART_sRX_RxSts__5__POS EQU 5
ProbeUART_BUART_sRX_RxSts__MASK EQU 0x38
ProbeUART_BUART_sRX_RxSts__MASK_REG EQU CYREG_B0_UDB03_MSK
ProbeUART_BUART_sRX_RxSts__STATUS_AUX_CTL_REG EQU CYREG_B0_UDB03_ACTL
ProbeUART_BUART_sRX_RxSts__STATUS_REG EQU CYREG_B0_UDB03_ST
ProbeUART_BUART_sTX_sCLOCK_TxBitClkGen__16BIT_A0_REG EQU CYREG_B0_UDB05_06_A0
ProbeUART_BUART_sTX_sCLOCK_TxBitClkGen__16BIT_A1_REG EQU CYREG_B0_UDB05_06_A1
ProbeUART_BUART_sTX_sCLOCK_TxBitClkGen__16BIT_D0_REG EQU CYREG_B0_UDB05_06_D0
ProbeUART_BUART_sTX_sCLOCK_TxBitClkGen__16BIT_D1_REG EQU CYREG_B0_UDB05_06_D1
ProbeUART_BUART_sTX_sCLOCK_TxBitClkGen__16BIT_DP_AUX_CTL_REG EQU CYREG_B0_UDB05_06_ACTL
ProbeUART_BUART_sTX_sCLOCK_TxBitClkGen__16BIT_F0_REG EQU CYREG_B0_UDB05_06_F0
ProbeUART_BUART_sTX_sCLOCK_TxBitClkGen__16BIT_F1_REG EQU CYREG_B0_UDB05_06_F1
ProbeUART_BUART_sTX_sCLOCK_TxBitClkGen__A0_A1_REG EQU CYREG_B0_UDB05_A0_A1
ProbeUART_BUART_sTX_sCLOCK_TxBitClkGen__A0_REG EQU CYREG_B0_UDB05_A0
ProbeUART_BUART_sTX_sCLOCK_TxBitClkGen__A1_REG EQU CYREG_B0_UDB05_A1
ProbeUART_BUART_sTX_sCLOCK_TxBitClkGen__D0_D1_REG EQU CYREG_B0_UDB05_D0_D1
ProbeUART_BUART_sTX_sCLOCK_TxBitClkGen__D0_REG EQU CYREG_B0_UDB05_D0
ProbeUART_BUART_sTX_sCLOCK_TxBitClkGen__D1_REG EQU CYREG_B0_UDB05_D1
ProbeUART_BUART_sTX_sCLOCK_TxBitClkGen__DP_AUX_CTL_REG EQU CYREG_B0_UDB05_ACTL
ProbeUART_BUART_sTX_sCLOCK_TxBitClkGen__F0_F1_REG EQU CYREG_B0_UDB05_F0_F1
ProbeUART_BUART_sTX_sCLOCK_TxBitClkGen__F0_REG EQU CYREG_B0_UDB05_F0
ProbeUART_BUART_sTX_sCLOCK_TxBitClkGen__F1_REG EQU CYREG_B0_UDB05_F1
ProbeUART_BUART_sTX_sCLOCK_TxBitClkGen__MSK_DP_AUX_CTL_REG EQU CYREG_B0_UDB05_MSK_ACTL
ProbeUART_BUART_sTX_sCLOCK_TxBitClkGen__PER_DP_AUX_CTL_REG EQU CYREG_B0_UDB05_MSK_ACTL
ProbeUART_BUART_sTX_TxShifter_u0__16BIT_A0_REG EQU CYREG_B0_UDB02_03_A0
ProbeUART_BUART_sTX_TxShifter_u0__16BIT_A1_REG EQU CYREG_B0_UDB02_03_A1
ProbeUART_BUART_sTX_TxShifter_u0__16BIT_D0_REG EQU CYREG_B0_UDB02_03_D0
ProbeUART_BUART_sTX_TxShifter_u0__16BIT_D1_REG EQU CYREG_B0_UDB02_03_D1
ProbeUART_BUART_sTX_TxShifter_u0__16BIT_DP_AUX_CTL_REG EQU CYREG_B0_UDB02_03_ACTL
ProbeUART_BUART_sTX_TxShifter_u0__16BIT_F0_REG EQU CYREG_B0_UDB02_03_F0
ProbeUART_BUART_sTX_TxShifter_u0__16BIT_F1_REG EQU CYREG_B0_UDB02_03_F1
ProbeUART_BUART_sTX_TxShifter_u0__A0_A1_REG EQU CYREG_B0_UDB02_A0_A1
ProbeUART_BUART_sTX_TxShifter_u0__A0_REG EQU CYREG_B0_UDB02_A0
ProbeUART_BUART_sTX_TxShifter_u0__A1_REG EQU CYREG_B0_UDB02_A1
ProbeUART_BUART_sTX_TxShifter_u0__D0_D1_REG EQU CYREG_B0_UDB02_D0_D1
ProbeUART_BUART_sTX_TxShifter_u0__D0_REG EQU CYREG_B0_UDB02_D0
ProbeUART_BUART_sTX_TxShifter_u0__D1_REG EQU CYREG_B0_UDB02_D1
ProbeUART_BUART_sTX_TxShifter_u0__DP_AUX_CTL_REG EQU CYREG_B0_UDB02_ACTL
ProbeUART_BUART_sTX_TxShifter_u0__F0_F1_REG EQU CYREG_B0_UDB02_F0_F1
ProbeUART_BUART_sTX_TxShifter_u0__F0_REG EQU CYREG_B0_UDB02_F0
ProbeUART_BUART_sTX_TxShifter_u0__F1_REG EQU CYREG_B0_UDB02_F1
ProbeUART_BUART_sTX_TxSts__0__MASK EQU 0x01
ProbeUART_BUART_sTX_TxSts__0__POS EQU 0
ProbeUART_BUART_sTX_TxSts__1__MASK EQU 0x02
ProbeUART_BUART_sTX_TxSts__1__POS EQU 1
ProbeUART_BUART_sTX_TxSts__16BIT_STATUS_AUX_CTL_REG EQU CYREG_B0_UDB02_03_ACTL
ProbeUART_BUART_sTX_TxSts__16BIT_STATUS_REG EQU CYREG_B0_UDB02_03_ST
ProbeUART_BUART_sTX_TxSts__2__MASK EQU 0x04
ProbeUART_BUART_sTX_TxSts__2__POS EQU 2
ProbeUART_BUART_sTX_TxSts__3__MASK EQU 0x08
ProbeUART_BUART_sTX_TxSts__3__POS EQU 3
ProbeUART_BUART_sTX_TxSts__MASK EQU 0x0F
ProbeUART_BUART_sTX_TxSts__MASK_REG EQU CYREG_B0_UDB02_MSK
ProbeUART_BUART_sTX_TxSts__STATUS_AUX_CTL_REG EQU CYREG_B0_UDB02_ACTL
ProbeUART_BUART_sTX_TxSts__STATUS_REG EQU CYREG_B0_UDB02_ST
ProbeUART_IntClock__CFG0 EQU CYREG_CLKDIST_DCFG0_CFG0
ProbeUART_IntClock__CFG1 EQU CYREG_CLKDIST_DCFG0_CFG1
ProbeUART_IntClock__CFG2 EQU CYREG_CLKDIST_DCFG0_CFG2
ProbeUART_IntClock__CFG2_SRC_SEL_MASK EQU 0x07
ProbeUART_IntClock__INDEX EQU 0x00
ProbeUART_IntClock__PM_ACT_CFG EQU CYREG_PM_ACT_CFG2
ProbeUART_IntClock__PM_ACT_MSK EQU 0x01
ProbeUART_IntClock__PM_STBY_CFG EQU CYREG_PM_STBY_CFG2
ProbeUART_IntClock__PM_STBY_MSK EQU 0x01
ProbeUART_Rx__0__INTTYPE EQU CYREG_PICU0_INTTYPE5
ProbeUART_Rx__0__MASK EQU 0x20
ProbeUART_Rx__0__PC EQU CYREG_PRT0_PC5
ProbeUART_Rx__0__PORT EQU 0
ProbeUART_Rx__0__SHIFT EQU 5
ProbeUART_Rx__AG EQU CYREG_PRT0_AG
ProbeUART_Rx__AMUX EQU CYREG_PRT0_AMUX
ProbeUART_Rx__BIE EQU CYREG_PRT0_BIE
ProbeUART_Rx__BIT_MASK EQU CYREG_PRT0_BIT_MASK
ProbeUART_Rx__BYP EQU CYREG_PRT0_BYP
ProbeUART_Rx__CTL EQU CYREG_PRT0_CTL
ProbeUART_Rx__DM0 EQU CYREG_PRT0_DM0
ProbeUART_Rx__DM1 EQU CYREG_PRT0_DM1
ProbeUART_Rx__DM2 EQU CYREG_PRT0_DM2
ProbeUART_Rx__DR EQU CYREG_PRT0_DR
ProbeUART_Rx__INP_DIS EQU CYREG_PRT0_INP_DIS
ProbeUART_Rx__INTTYPE_BASE EQU CYDEV_PICU_INTTYPE_PICU0_BASE
ProbeUART_Rx__LCD_COM_SEG EQU CYREG_PRT0_LCD_COM_SEG
ProbeUART_Rx__LCD_EN EQU CYREG_PRT0_LCD_EN
ProbeUART_Rx__MASK EQU 0x20
ProbeUART_Rx__PORT EQU 0
ProbeUART_Rx__PRT EQU CYREG_PRT0_PRT
ProbeUART_Rx__PRTDSI__CAPS_SEL EQU CYREG_PRT0_CAPS_SEL
ProbeUART_Rx__PRTDSI__DBL_SYNC_IN EQU CYREG_PRT0_DBL_SYNC_IN
ProbeUART_Rx__PRTDSI__OE_SEL0 EQU CYREG_PRT0_OE_SEL0
ProbeUART_Rx__PRTDSI__OE_SEL1 EQU CYREG_PRT0_OE_SEL1
ProbeUART_Rx__PRTDSI__OUT_SEL0 EQU CYREG_PRT0_OUT_SEL0
ProbeUART_Rx__PRTDSI__OUT_SEL1 EQU CYREG_PRT0_OUT_SEL1
ProbeUART_Rx__PRTDSI__SYNC_OUT EQU CYREG_PRT0_SYNC_OUT
ProbeUART_Rx__PS EQU CYREG_PRT0_PS
ProbeUART_Rx__SHIFT EQU 5
ProbeUART_Rx__SLW EQU CYREG_PRT0_SLW
ProbeUART_RxISR__INTC_CLR_EN_REG EQU CYREG_NVIC_CLRENA0
ProbeUART_RxISR__INTC_CLR_PD_REG EQU CYREG_NVIC_CLRPEND0
ProbeUART_RxISR__INTC_MASK EQU 0x01
ProbeUART_RxISR__INTC_NUMBER EQU 0
ProbeUART_RxISR__INTC_PRIOR_NUM EQU 7
ProbeUART_RxISR__INTC_PRIOR_REG EQU CYREG_NVIC_PRI_0
ProbeUART_RxISR__INTC_SET_EN_REG EQU CYREG_NVIC_SETENA0
ProbeUART_RxISR__INTC_SET_PD_REG EQU CYREG_NVIC_SETPEND0
ProbeUART_Tx__0__INTTYPE EQU CYREG_PICU0_INTTYPE4
ProbeUART_Tx__0__MASK EQU 0x10
ProbeUART_Tx__0__PC EQU CYREG_PRT0_PC4
ProbeUART_Tx__0__PORT EQU 0
ProbeUART_Tx__0__SHIFT EQU 4
ProbeUART_Tx__AG EQU CYREG_PRT0_AG
ProbeUART_Tx__AMUX EQU CYREG_PRT0_AMUX
ProbeUART_Tx__BIE EQU CYREG_PRT0_BIE
ProbeUART_Tx__BIT_MASK EQU CYREG_PRT0_BIT_MASK
ProbeUART_Tx__BYP EQU CYREG_PRT0_BYP
ProbeUART_Tx__CTL EQU CYREG_PRT0_CTL
ProbeUART_Tx__DM0 EQU CYREG_PRT0_DM0
ProbeUART_Tx__DM1 EQU CYREG_PRT0_DM1
ProbeUART_Tx__DM2 EQU CYREG_PRT0_DM2
ProbeUART_Tx__DR EQU CYREG_PRT0_DR
ProbeUART_Tx__INP_DIS EQU CYREG_PRT0_INP_DIS
ProbeUART_Tx__INTTYPE_BASE EQU CYDEV_PICU_INTTYPE_PICU0_BASE
ProbeUART_Tx__LCD_COM_SEG EQU CYREG_PRT0_LCD_COM_SEG
ProbeUART_Tx__LCD_EN EQU CYREG_PRT0_LCD_EN
ProbeUART_Tx__MASK EQU 0x10
ProbeUART_Tx__PORT EQU 0
ProbeUART_Tx__PRT EQU CYREG_PRT0_PRT
ProbeUART_Tx__PRTDSI__CAPS_SEL EQU CYREG_PRT0_CAPS_SEL
ProbeUART_Tx__PRTDSI__DBL_SYNC_IN EQU CYREG_PRT0_DBL_SYNC_IN
ProbeUART_Tx__PRTDSI__OE_SEL0 EQU CYREG_PRT0_OE_SEL0
ProbeUART_Tx__PRTDSI__OE_SEL1 EQU CYREG_PRT0_OE_SEL1
ProbeUART_Tx__PRTDSI__OUT_SEL0 EQU CYREG_PRT0_OUT_SEL0
ProbeUART_Tx__PRTDSI__OUT_SEL1 EQU CYREG_PRT0_OUT_SEL1
ProbeUART_Tx__PRTDSI__SYNC_OUT EQU CYREG_PRT0_SYNC_OUT
ProbeUART_Tx__PS EQU CYREG_PRT0_PS
ProbeUART_Tx__SHIFT EQU 4
ProbeUART_Tx__SLW EQU CYREG_PRT0_SLW
ProbeUART_TxISR__INTC_CLR_EN_REG EQU CYREG_NVIC_CLRENA0
ProbeUART_TxISR__INTC_CLR_PD_REG EQU CYREG_NVIC_CLRPEND0
ProbeUART_TxISR__INTC_MASK EQU 0x02
ProbeUART_TxISR__INTC_NUMBER EQU 1
ProbeUART_TxISR__INTC_PRIOR_NUM EQU 7
ProbeUART_TxISR__INTC_PRIOR_REG EQU CYREG_NVIC_PRI_1
ProbeUART_TxISR__INTC_SET_EN_REG EQU CYREG_NVIC_SETENA0
ProbeUART_TxISR__INTC_SET_PD_REG EQU CYREG_NVIC_SETPEND0

/* Miscellaneous */
BCLK__BUS_CLK__HZ EQU 60000000
BCLK__BUS_CLK__KHZ EQU 60000
BCLK__BUS_CLK__MHZ EQU 60
CYDEV_CHIP_DIE_LEOPARD EQU 1
CYDEV_CHIP_DIE_PSOC4A EQU 26
CYDEV_CHIP_DIE_PSOC5LP EQU 2
CYDEV_CHIP_DIE_PSOC5TM EQU 3
CYDEV_CHIP_DIE_TMA4 EQU 4
CYDEV_CHIP_DIE_UNKNOWN EQU 0
CYDEV_CHIP_FAMILY_FM0P EQU 5
CYDEV_CHIP_FAMILY_FM3 EQU 6
CYDEV_CHIP_FAMILY_FM4 EQU 7
CYDEV_CHIP_FAMILY_PSOC3 EQU 1
CYDEV_CHIP_FAMILY_PSOC4 EQU 2
CYDEV_CHIP_FAMILY_PSOC5 EQU 3
CYDEV_CHIP_FAMILY_PSOC6 EQU 4
CYDEV_CHIP_FAMILY_UNKNOWN EQU 0
CYDEV_CHIP_FAMILY_USED EQU CYDEV_CHIP_FAMILY_PSOC5
CYDEV_CHIP_JTAG_ID EQU 0x2E120069
CYDEV_CHIP_MEMBER_3A EQU 1
CYDEV_CHIP_MEMBER_4A EQU 26
CYDEV_CHIP_MEMBER_4AA EQU 25
CYDEV_CHIP_MEMBER_4AB EQU 30
CYDEV_CHIP_MEMBER_4AC EQU 14
CYDEV_CHIP_MEMBER_4AD EQU 15
CYDEV_CHIP_MEMBER_4AE EQU 16
CYDEV_CHIP_MEMBER_4D EQU 20
CYDEV_CHIP_MEMBER_4E EQU 6
CYDEV_CHIP_MEMBER_4F EQU 27
CYDEV_CHIP_MEMBER_4G EQU 4
CYDEV_CHIP_MEMBER_4H EQU 24
CYDEV_CHIP_MEMBER_4I EQU 32
CYDEV_CHIP_MEMBER_4J EQU 21
CYDEV_CHIP_MEMBER_4K EQU 22
CYDEV_CHIP_MEMBER_4L EQU 31
CYDEV_CHIP_MEMBER_4M EQU 29
CYDEV_CHIP_MEMBER_4N EQU 11
CYDEV_CHIP_MEMBER_4O EQU 8
CYDEV_CHIP_MEMBER_4P EQU 28
CYDEV_CHIP_MEMBER_4Q EQU 17
CYDEV_CHIP_MEMBER_4R EQU 9
CYDEV_CHIP_MEMBER_4S EQU 12
CYDEV_CHIP_MEMBER_4T EQU 10
CYDEV_CHIP_MEMBER_4U EQU 5
CYDEV_CHIP_MEMBER_4V EQU 23
CYDEV_CHIP_MEMBER_4W EQU 13
CYDEV_CHIP_MEMBER_4X EQU 7
CYDEV_CHIP_MEMBER_4Y EQU 18
CYDEV_CHIP_MEMBER_4Z EQU 19
CYDEV_CHIP_MEMBER_5A EQU 3
CYDEV_CHIP_MEMBER_5B EQU 2
CYDEV_CHIP_MEMBER_6A EQU 33
CYDEV_CHIP_MEMBER_FM3 EQU 37
CYDEV_CHIP_MEMBER_FM4 EQU 38
CYDEV_CHIP_MEMBER_PDL_FM0P_TYPE1 EQU 34
CYDEV_CHIP_MEMBER_PDL_FM0P_TYPE2 EQU 35
CYDEV_CHIP_MEMBER_PDL_FM0P_TYPE3 EQU 36
CYDEV_CHIP_MEMBER_UNKNOWN EQU 0
CYDEV_CHIP_MEMBER_USED EQU CYDEV_CHIP_MEMBER_5B
CYDEV_CHIP_DIE_EXPECT EQU CYDEV_CHIP_MEMBER_USED
CYDEV_CHIP_DIE_ACTUAL EQU CYDEV_CHIP_DIE_EXPECT
CYDEV_CHIP_REV_LEOPARD_ES1 EQU 0
CYDEV_CHIP_REV_LEOPARD_ES2 EQU 1
CYDEV_CHIP_REV_LEOPARD_ES3 EQU 3
CYDEV_CHIP_REV_LEOPARD_PRODUCTION EQU 3
CYDEV_CHIP_REV_PSOC4A_ES0 EQU 17
CYDEV_CHIP_REV_PSOC4A_PRODUCTION EQU 17
CYDEV_CHIP_REV_PSOC5LP_ES0 EQU 0
CYDEV_CHIP_REV_PSOC5LP_PRODUCTION EQU 0
CYDEV_CHIP_REV_PSOC5TM_ES0 EQU 0
CYDEV_CHIP_REV_PSOC5TM_ES1 EQU 1
CYDEV_CHIP_REV_PSOC5TM_PRODUCTION EQU 1
CYDEV_CHIP_REV_TMA4_ES EQU 17
CYDEV_CHIP_REV_TMA4_ES2 EQU 33
CYDEV_CHIP_REV_TMA4_PRODUCTION EQU 17
CYDEV_CHIP_REVISION_3A_ES1 EQU 0
CYDEV_CHIP_REVISION_3A_ES2 EQU 1
CYDEV_CHIP_REVISION_3A_ES3 EQU 3
CYDEV_CHIP_REVISION_3A_PRODUCTION EQU 3
CYDEV_CHIP_REVISION_4A_ES0 EQU 17
CYDEV_CHIP_REVISION_4A_PRODUCTION EQU 17
CYDEV_CHIP_REVISION_4AA_PRODUCTION EQU 0
CYDEV_CHIP_REVISION_4AB_PRODUCTION EQU 0
CYDEV_CHIP_REVISION_4AC_PRODUCTION EQU 0
CYDEV_CHIP_REVISION_4AD_PRODUCTION EQU 0
CYDEV_CHIP_REVISION_4AE_PRODUCTION EQU 0
CYDEV_CHIP_REVISION_4D_PRODUCTION EQU 0
CYDEV_CHIP_REVISION_4E_CCG2_NO_USBPD EQU 0
CYDEV_CHIP_REVISION_4E_PRODUCTION EQU 0
CYDEV_CHIP_REVISION_4F_PRODUCTION EQU 0
CYDEV_CHIP_REVISION_4F_PRODUCTION_256DMA EQU 0
CYDEV_CHIP_REVISION_4F_PRODUCTION_256K EQU 0
CYDEV_CHIP_REVISION_4G_ES EQU 17
CYDEV_CHIP_REVISION_4G_ES2 EQU 33
CYDEV_CHIP_REVISION_4G_PRODUCTION EQU 17
CYDEV_CHIP_REVISION_4H_PRODUCTION EQU 0
CYDEV_CHIP_REVISION_4I_PRODUCTION EQU 0
CYDEV_CHIP_REVISION_4J_PRODUCTION EQU 0
CYDEV_CHIP_REVISION_4K_PRODUCTION EQU 0
CYDEV_CHIP_REVISION_4L_PRODUCTION EQU 0
CYDEV_CHIP_REVISION_4M_PRODUCTION EQU 0
CYDEV_CHIP_REVISION_4N_PRODUCTION EQU 0
CYDEV_CHIP_REVISION_4O_PRODUCTION EQU 0
CYDEV_CHIP_REVISION_4P_PRODUCTION EQU 0
CYDEV_CHIP_REVISION_4Q_PRODUCTION EQU 0
CYDEV_CHIP_REVISION_4R_PRODUCTION EQU 0
CYDEV_CHIP_REVISION_4S_PRODUCTION EQU 0
CYDEV_CHIP_REVISION_4T_PRODUCTION EQU 0
CYDEV_CHIP_REVISION_4U_PRODUCTION EQU 0
CYDEV_CHIP_REVISION_4V_PRODUCTION EQU 0
CYDEV_CHIP_REVISION_4W_PRODUCTION EQU 0
CYDEV_CHIP_REVISION_4X_PRODUCTION EQU 0
CYDEV_CHIP_REVISION_4Y_PRODUCTION EQU 0
CYDEV_CHIP_REVISION_4Z_PRODUCTION EQU 0
CYDEV_CHIP_REVISION_5A_ES0 EQU 0
CYDEV_CHIP_REVISION_5A_ES1 EQU 1
CYDEV_CHIP_REVISION_5A_PRODUCTION EQU 1
CYDEV_CHIP_REVISION_5B_ES0 EQU 0
CYDEV_CHIP_REVISION_5B_PRODUCTION EQU 0
CYDEV_CHIP_REVISION_6A_ES EQU 17
CYDEV_CHIP_REVISION_6A_NO_UDB EQU 33
CYDEV_CHIP_REVISION_6A_PRODUCTION EQU 33
CYDEV_CHIP_REVISION_FM3_PRODUCTION EQU 0
CYDEV_CHIP_REVISION_FM4_PRODUCTION EQU 0
CYDEV_CHIP_REVISION_PDL_FM0P_TYPE1_PRODUCTION EQU 0
CYDEV_CHIP_REVISION_PDL_FM0P_TYPE2_PRODUCTION EQU 0
CYDEV_CHIP_REVISION_PDL_FM0P_TYPE3_PRODUCTION EQU 0
CYDEV_CHIP_REVISION_USED EQU CYDEV_CHIP_REVISION_5B_PRODUCTION
CYDEV_CHIP_REV_EXPECT EQU CYDEV_CHIP_REVISION_USED
CYDEV_CONFIG_FASTBOOT_ENABLED EQU 0
CYDEV_CONFIG_UNUSED_IO_AllowButWarn EQU 0
CYDEV_CONFIG_UNUSED_IO EQU CYDEV_CONFIG_UNUSED_IO_AllowButWarn
CYDEV_CONFIG_UNUSED_IO_AllowWithInfo EQU 1
CYDEV_CONFIG_UNUSED_IO_Disallowed EQU 2
CYDEV_CONFIGURATION_COMPRESSED EQU 1
CYDEV_CONFIGURATION_DMA EQU 0
CYDEV_CONFIGURATION_ECC EQU 1
CYDEV_CONFIGURATION_IMOENABLED EQU CYDEV_CONFIG_FASTBOOT_ENABLED
CYDEV_CONFIGURATION_MODE_COMPRESSED EQU 0
CYDEV_CONFIGURATION_MODE EQU CYDEV_CONFIGURATION_MODE_COMPRESSED
CYDEV_CONFIGURATION_MODE_DMA EQU 2
CYDEV_CONFIGURATION_MODE_UNCOMPRESSED EQU 1
CYDEV_DEBUG_ENABLE_MASK EQU 0x20
CYDEV_DEBUG_ENABLE_REGISTER EQU CYREG_MLOGIC_DEBUG
CYDEV_DEBUGGING_DPS_Disable EQU 3
CYDEV_DEBUGGING_DPS_JTAG_4 EQU 1
CYDEV_DEBUGGING_DPS_JTAG_5 EQU 0
CYDEV_DEBUGGING_DPS_SWD EQU 2
CYDEV_DEBUGGING_DPS_SWD_SWV EQU 6
CYDEV_DEBUGGING_DPS EQU CYDEV_DEBUGGING_DPS_SWD_SWV
CYDEV_DEBUGGING_ENABLE EQU 1
CYDEV_DEBUGGING_XRES EQU 0
CYDEV_DMA_CHANNELS_AVAILABLE EQU 24
CYDEV_ECC_ENABLE EQU 0
CYDEV_HEAP_SIZE EQU 0x80
CYDEV_INSTRUCT_CACHE_ENABLED EQU 1
CYDEV_INTR_RISING EQU 0x00000003
CYDEV_IS_EXPORTING_CODE EQU 0
CYDEV_IS_IMPORTING_CODE EQU 0
CYDEV_PROJ_TYPE EQU 0
CYDEV_PROJ_TYPE_BOOTLOADER EQU 1
CYDEV_PROJ_TYPE_LAUNCHER EQU 5
CYDEV_PROJ_TYPE_LOADABLE EQU 2
CYDEV_PROJ_TYPE_LOADABLEANDBOOTLOADER EQU 4
CYDEV_PROJ_TYPE_MULTIAPPBOOTLOADER EQU 3
CYDEV_PROJ_TYPE_STANDARD EQU 0
CYDEV_PROTECTION_ENABLE EQU 0
CYDEV_STACK_SIZE EQU 0x0800
CYDEV_USE_BUNDLED_CMSIS EQU 1
CYDEV_VARIABLE_VDDA EQU 0
CYDEV_VDDA_MV EQU 5000
CYDEV_VDDD_MV EQU 5000
CYDEV_VDDIO0_MV EQU 5000
CYDEV_VDDIO1_MV EQU 5000
CYDEV_VDDIO2_MV EQU 5000
CYDEV_VDDIO3_MV EQU 5000
CYDEV_VIO0_MV EQU 5000
CYDEV_VIO1_MV EQU 5000
CYDEV_VIO2_MV EQU 5000
CYDEV_VIO3_MV EQU 5000
CYIPBLOCK_ARM_CM3_VERSION EQU 0
CYIPBLOCK_P3_ANAIF_VERSION EQU 0
CYIPBLOCK_P3_CAPSENSE_VERSION EQU 0
CYIPBLOCK_P3_COMP_VERSION EQU 0
CYIPBLOCK_P3_DECIMATOR_VERSION EQU 0
CYIPBLOCK_P3_DFB_VERSION EQU 0
CYIPBLOCK_P3_DMA_VERSION EQU 0
CYIPBLOCK_P3_DRQ_VERSION EQU 0
CYIPBLOCK_P3_DSM_VERSION EQU 0
CYIPBLOCK_P3_EMIF_VERSION EQU 0
CYIPBLOCK_P3_I2C_VERSION EQU 0
CYIPBLOCK_P3_LCD_VERSION EQU 0
CYIPBLOCK_P3_LPF_VERSION EQU 0
CYIPBLOCK_P3_OPAMP_VERSION EQU 0
CYIPBLOCK_P3_PM_VERSION EQU 0
CYIPBLOCK_P3_SCCT_VERSION EQU 0
CYIPBLOCK_P3_TIMER_VERSION EQU 0
CYIPBLOCK_P3_USB_VERSION EQU 0
CYIPBLOCK_P3_VIDAC_VERSION EQU 0
CYIPBLOCK_P3_VREF_VERSION EQU 0
CYIPBLOCK_S8_GPIO_VERSION EQU 0
CYIPBLOCK_S8_IRQ_VERSION EQU 0
CYIPBLOCK_S8_SAR_VERSION EQU 0
CYIPBLOCK_S8_SIO_VERSION EQU 0
CYIPBLOCK_S8_UDB_VERSION EQU 0
DMA_CHANNELS_USED__MASK0 EQU 0x00000000
CYDEV_BOOTLOADER_ENABLE EQU 0

#endif /* INCLUDED_CYFITTERIAR_INC */
